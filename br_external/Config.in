## br_external/Config.in
```kconfig
source "$BR2_EXTERNAL_AUTOBALANCER_PATH/package/autobalancer/Config.in"
source "$BR2_EXTERNAL_AUTOBALANCER_PATH/package/motor-driver/Config.in"
```

## br_external/configs/autobalancer_defconfig
```kconfig
BR2_arm=y
BR2_arm1176jzf_s=y
BR2_CCACHE=y
BR2_TOOLCHAIN_EXTERNAL=y
BR2_TOOLCHAIN_EXTERNAL_CUSTOM=y
BR2_TOOLCHAIN_EXTERNAL_DOWNLOAD=y
BR2_TOOLCHAIN_EXTERNAL_URL="https://github.com/rvagg/rpi-newer-crosstools/archive/eb68350c5c8ec1663b7fe52c742ac4271e3217c5.tar.gz"
BR2_TOOLCHAIN_EXTERNAL_REL_BIN_PATH="x64-gcc-6.5.0/arm-rpi-linux-gnueabihf/bin"
BR2_TOOLCHAIN_EXTERNAL_CUSTOM_PREFIX="arm-rpi-linux-gnueabihf"
BR2_TOOLCHAIN_EXTERNAL_GCC_6=y
BR2_TOOLCHAIN_EXTERNAL_HEADERS_4_4=y
BR2_TOOLCHAIN_EXTERNAL_CUSTOM_GLIBC=y
BR2_TOOLCHAIN_EXTERNAL_CXX=y
BR2_ROOTFS_DEVICE_CREATION_DYNAMIC_MDEV=y
BR2_SYSTEM_BIN_SH_BASH=y
BR2_ROOTFS_POST_BUILD_SCRIPT="${BR2_EXTERNAL}/board/post-build.sh"
BR2_ROOTFS_POST_IMAGE_SCRIPT="${BR2_EXTERNAL}/board/post-image.sh"
BR2_LINUX_KERNEL=y
BR2_LINUX_KERNEL_CUSTOM_TARBALL=y
BR2_LINUX_KERNEL_CUSTOM_TARBALL_LOCATION="$(call github,raspberrypi,linux,b657cd2f27d9171b75c846f21e7b4bb581b3ed29)/linux-b657cd2f27d9171b75c846f21e7b4bb581b3ed29.tar.gz"
BR2_LINUX_KERNEL_DEFCONFIG="bcmrpi"
BR2_LINUX_KERNEL_DTS_SUPPORT=y
BR2_LINUX_KERNEL_INTREE_DTS_NAME="bcm2708-rpi-zero-w"
BR2_LINUX_KERNEL_NEEDS_HOST_OPENSSL=y
BR2_PACKAGE_BUSYBOX_SHOW_OTHERS=y
BR2_PACKAGE_RPI_FIRMWARE=y
BR2_PACKAGE_RPI_FIRMWARE_BOOTCODE_BIN=y
BR2_PACKAGE_RPI_FIRMWARE_VARIANT_PI=y
BR2_PACKAGE_RPI_WIFI_FIRMWARE=y
BR2_PACKAGE_I2C_TOOLS=y
BR2_PACKAGE_HAVEGED=y
BR2_PACKAGE_OPENSSH=y
BR2_PACKAGE_WPA_SUPPLICANT=y
BR2_PACKAGE_WPA_SUPPLICANT_PASSPHRASE=y
BR2_TARGET_ROOTFS_EXT2=y
BR2_TARGET_ROOTFS_EXT2_4=y
BR2_TARGET_ROOTFS_EXT2_SIZE="120M"
# BR2_TARGET_ROOTFS_TAR is not set
BR2_PACKAGE_HOST_DOSFSTOOLS=y
BR2_PACKAGE_HOST_GENIMAGE=y
BR2_PACKAGE_HOST_MTOOLS=y
BR2_AUTOBALANCER_CONFIG=y
BR2_PACKAGE_AUTOBALANCER_PID=y
BR2_PACKAGE_AUTOBALANCER_ML=y
BR2_PACKAGE_MOTOR_DRIVER=y
```

## br_external/package/autobalancer/Config.in
```kconfig
menuconfig BR2_AUTOBALANCER_CONFIG
	bool "autobalancer"
  depends on BR2_PACKAGE_MOTOR_DRIVER
  depends on BR2_PACKAGE_I2C_TOOLS
	help
    Autobalancer package options

if BR2_AUTOBALANCER_CONFIG

  config BR2_PACKAGE_AUTOBALANCER_PID
    bool "PID based"

  config BR2_PACKAGE_AUTOBALANCER_ML
    bool "ML based"

endif
```

## br_external/package/motor-driver/Config.in
```kconfig
config BR2_PACKAGE_MOTOR_DRIVER
  bool "motor_driver"
  depends on BR2_LINUX_KERNEL
  help
    Custom Motor Driver as a Linux Kernel Module
```

## br_external/package/tensorflow-lite/Config.in
```kconfig
config BR2_PACKAGE_TENSORFLOW_LITE
  bool "tensorflow-lite"
  depends on BR2_LINUX_KERNEL
  help
    Tensorflow lite library
```
